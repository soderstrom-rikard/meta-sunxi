## conf/machine/chip.conf
```bitbake
#@TYPE: Machine
#@NAME: NextThing Co C.H.I.P - Allwinner R8
#@DESCRIPTION: Machine configuration for the NexThing Co C.H.I.P Board, based on Allwinner R8
#https://github.com/NextThingCo/CHIP-u-boot
#https://github.com/NextThingCo/CHIP-linux

PREFERRED_PROVIDER_virtual/kernel ?= "linux-chip"
PREFERRED_PROVIDER_u-boot ?= "u-boot-chip"
PREFERRED_PROVIDER_virtual/bootloader ?= "u-boot-chip"
PREFERRED_VERSION_linux-chip ?= "4.3.0"
PREFFERED_VERSION_u-boot-chip ?= "v2015.10%"
KERNEL_IMAGETYPE ?= "zImage"

require conf/machine/include/sun5i.inc

IMAGE_INSTALL_append = " kernel-devicetree kernel-image kernel-modules"
MKUBIFS_ARGS        = "-e 0x1f8000 -c 2000 -m 0x4000 -x lzo"
UBINIZE_ARGS        = "-m 0x4000 -p 0x200000 -s 16384"
IMAGE_CLASSES       = ""
IMAGE_FSTYPES       = "ext4 tar.gz ubi ubifs"
KERNEL_DEVICETREE   = "sun5i-r8-chip.dtb"
UBOOT_MACHINE_chip  = "CHIP_config"
```
